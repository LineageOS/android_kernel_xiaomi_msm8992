/* Copyright (c) 2014-2015 The Linux Foundation. All rights reserved.
 * Copyright (C) 2016 XiaoMi, Inc.
 * Modified by Ketut Putu Kumajaya, 2016
 *
 * This program is free software; you can redistribute it and/or modify
 * it under the terms of the GNU General Public License version 2 and
 * only version 2 as published by the Free Software Foundation.
 *
 * This program is distributed in the hope that it will be useful,
 * but WITHOUT ANY WARRANTY; without even the implied warranty of
 * MERCHANTABILITY or FITNESS FOR A PARTICULAR PURPOSE.  See the
 * GNU General Public License for more details.
 */

#include "../msm8992-mdss.dtsi"

&soc {
	mdss_hdmi_tx: qcom,hdmi_tx@fd9a0000{
		status = "disable";
	};
};

#include "dsi-panel-sharp-rsp61322-1080p-video.dtsi"
#include "dsi-panel-auo-nt35596-1080p-video.dtsi"
#include "dsi-panel-lgd-nt35596-1080p-video.dtsi"
#include "dsi-panel-sharp-nt35595-1080p-video-ram.dtsi"
#include "dsi-panel-jdi-nt35595-1080p-video-ram.dtsi"
#include "dsi-panel-sharp-nt35595-1080p-command.dtsi"
