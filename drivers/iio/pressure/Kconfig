## drivers/iio/pressure/Kconfig
```kconfig
#
# Pressure drivers
#
menu "Pressure Sensors"

config BMP280
	tristate "BMP280 digital pressure sensor"
	depends on (I2C || SPI_MASTER) && SYSFS
	help
	  If you say yes here you get support for Bosch Sensortec
	  digital pressure sensors BMP280.

	  To compile this driver as a module, choose M here: the
	  module will be called bmp280-core.

config BMP280_I2C
	tristate "support I2C bus communication"
	depends on BMP280 && I2C
	help
	  Say Y here if you want to support Bosch Sensortec digital pressure
	  sensor hooked to an I2C bus.

	  To compile this driver as a module, choose M here: the
	  module will be called bmp280-i2c.

config BMP280_SPI
	tristate "support SPI bus communication"
	depends on BMP280 && SPI_MASTER
	help
	  Say Y here if you want to support Bosch Sensortec digital pressure
	  sensor hooked to an SPI bus.

	  To compile this driver as a module, choose M here: the
	  module will be called bmp280-spi.


endmenu
```

## drivers/input/fingerprint/Kconfig
```kconfig
config FINGERPRINT_AQUA
	tristate "Mi4S fingerprint support"
	depends on SPI
	help
	  Say Y here if you have a Mi4s.
```

## drivers/platform/xiaomi/Kconfig
```kconfig
# Xiaomi configuration options

config MACH_XIAOMI
	bool "Xiaomi device"
	depends on ARCH_MSM
	help
		Support for Xiaomi products

config MACH_XIAOMI_MSM8992
	bool "Xiaomi MSM8992"
	depends on ARCH_MSM8992 || ARCH_MSM8994
	select MACH_XIAOMI
	help
		Support for MSM8992 Xiaomi variants

menu "Xiaomi board selection"

config MACH_LIBRA
	bool "Libra board"
	select MACH_XIAOMI_MSM8992
	help
		Support for Xiaomi Libra variant

config MACH_LEO
	bool "Leo board"
	select MACH_XIAOMI_MSM8992
	help
		Support for Xiaomi Leo variant

endmenu
```
